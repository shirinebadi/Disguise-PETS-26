## srsue/buildroot-package/Config.in
```kconfig
config BR2_PACKAGE_SRSRAN
	bool "srsue"
	depends on BR2_INSTALL_LIBSTDCPP
	depends on BR2_TOOLCHAIN_HAS_THREADS
	select BR2_PACKAGE_FFTW_SINGLE
	select BR2_PACKAGE_PCSC_LITE
	select BR2_PACKAGE_MBEDTLS
	select BR2_PACKAGE_LKSCTP_TOOLS
	select BR2_PACKAGE_LIBCONFIG
	select BR2_PACKAGE_ZEROMQ
 	select BR2_PACKAGE_CZMQ
	select BR2_PACKAGE_BOOST
	select BR2_PACKAGE_BOOST_PROGRAM_OPTIONS
	help
	  Software Radio Systems RAN (srsRAN) is a 4G/5G software 
	  radio suite developed by SRS.

	  https://www.srsran.com
```
